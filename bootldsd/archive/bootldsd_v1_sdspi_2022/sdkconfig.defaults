## bootldsd/archive/bootldsd_v1_sdspi_2022/sdkconfig.defaults
```kconfig
CONFIG_IDF_CMAKE=y
CONFIG_FREERTOS_WATCHPOINT_END_OF_STACK=y
CONFIG_FREERTOS_SUPPORT_STATIC_ALLOCATION=y

# Partition Table
CONFIG_PARTITION_TABLE_CUSTOM=y
CONFIG_PARTITION_TABLE_OFFSET=0x8000
CONFIG_PARTITION_TABLE_MD5=y

# Compiler options
CONFIG_COMPILER_OPTIMIZATION_SIZE=y
CONFIG_COMPILER_OPTIMIZATION_ASSERTIONS_SILENT=y

# Newlib
CONFIG_NEWLIB_NANO_FORMAT=y

# Virtual file system
CONFIG_VFS_SUPPORT_IO=n

# Compatibility options
CONFIG_FLASHMODE_QIO=y

CONFIG_FATFS_CODEPAGE=866
CONFIG_VFS_SUPPORT_IO=y
CONFIG_VFS_SUPPORT_DIR=y
CONFIG_VFS_SUPPORT_SELECT=y
CONFIG_VFS_SUPPRESS_SELECT_DEBUG_OUTPUT=y
CONFIG_VFS_SUPPORT_TERMIOS=y
CONFIG_VFS_SEMIHOSTFS_MAX_MOUNT_POINTS=1
CONFIG_VFS_SEMIHOSTFS_HOST_PATH_MAX_LEN=128
```

## sdkconfig.defaults
```kconfig
# moduleBox build defaults.
# Persisted here so an idf.py set-target / menuconfig regen of sdkconfig keeps
# the internal-RAM (DRAM) tuning. Edit here AND in sdkconfig when changing.

# --- Internal-RAM (DRAM) tuning ---------------------------------------------
# Move Wi-Fi/LWIP dynamic buffers to PSRAM (biggest internal-RAM win).
CONFIG_SPIRAM_TRY_ALLOCATE_WIFI_LWIP=y

# Trim Wi-Fi buffer pools (control-plane traffic: MQTT/OSC/UDP, not bulk).
CONFIG_ESP_WIFI_STATIC_RX_BUFFER_NUM=6
CONFIG_ESP_WIFI_DYNAMIC_RX_BUFFER_NUM=16
CONFIG_ESP_WIFI_STATIC_TX_BUFFER_NUM=8

# Smaller TCP windows + UDP mailbox (64 was anomalously high).
CONFIG_LWIP_TCP_SND_BUF_DEFAULT=2880
CONFIG_LWIP_TCP_WND_DEFAULT=2880
CONFIG_LWIP_UDP_RECVMBOX_SIZE=16

# Put the mDNS task stack + allocations in PSRAM (also stops the OOM abort
# in start_mdns_task when internal RAM is tight).
CONFIG_MDNS_TASK_CREATE_FROM_SPIRAM=y
CONFIG_MDNS_MEMORY_ALLOC_SPIRAM=y

# --- System event task stack ------------------------------------------------
# LAN/WIFI event handlers write link up/down transitions to the SD log via
# mblog() (FATFS fopen/fwrite). The default 2304 B stack is too tight for a
# file write from this context - bump to 4096 to avoid stack overflow.
CONFIG_ESP_SYSTEM_EVENT_TASK_STACK_SIZE=4096
```
